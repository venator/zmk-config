## boards/shields/forager/Kconfig.shield
```kconfig
# No whitespace after the comma or in the keyboard name!
config SHIELD_FORAGER_DONGLE
    def_bool $(shields_list_contains,forager_dongle)
```

## boards/shields/urchin/Kconfig.shield
```kconfig
# No whitespace after the comma or in the keyboard name!
config SHIELD_URCHIN_DONGLE
    def_bool $(shields_list_contains,urchin_dongle)
```

## config/west.yml
```yaml
manifest:
  remotes:
    # zmk official
    - name: zmkfirmware
      url-base: https://github.com/zmkfirmware
    # Urchin
    # urob
    #- name: urob
    #  url-base: https://github.com/urob
    # bravekarma
    - name: caksoylar
      url-base: https://github.com/caksoylar
    # kyek / duckyb
    - name: duckyb
      url-base: https://github.com/duckyb
    # OPTIONAL nice-view-gem (gem animation)
    #- name: m165437
    #  url-base: https://github.com/M165437
    # OPTIONAL nice-view ulounge (urchin animation)
    #- name: ulounge
    #  url-base: https://github.com/ulounge
    # Forager
    - name: carrefinho
      url-base: https://github.com/carrefinho
    # Raytac dongle
    - name: rschenk
      url-base: https://github.com/rschenk
  projects:
    - name: zmk
      remote: zmkfirmware
      revision: main
      import: app/west.yml
    # Urchin
    #- name: zmk-helpers
    #  remote: urob
    #  revision: main
    - name: urchin-zmk-module
      remote: duckyb
      revision: main
    #- name: nice-view-gem
    #  remote: m165437
    #  revision: main
    #- name: nice-view-mod
    #  remote: ulounge
    #  revision: main
    # Forager
    - name: forager-zmk-module
      remote: carrefinho
      revision: main
    - name: zmk-rgbled-widget
      remote: caksoylar
      revision: main
    - name: zmk-component-raytac-dongle
      remote: rschenk
      revision: main
  self:
    path: config
```
